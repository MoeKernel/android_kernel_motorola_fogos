## drivers/input/misc/focal_fps_mmi/Kconfig
```kconfig
config INPUT_FOCAL_FPS_MMI
	tristate "MMI Focaltech fingerprint sensor"
	default n
	help
	  Say Y here if you wish to include support for MMI focaltech fingerprint sensor.
	  If unsure, say N.

config INPUT_FOCAL_SUPPORT_DRM_SCREEN
	bool "MMI Focaltech fingerprint sensor DRM panel notifications"
	depends on INPUT_FOCAL_FPS_MMI
	default n
	help
	  Enable DRM panel notifications for MMI Focaltech fingerprint sensor.

config INPUT_FOCAL_PANEL_NOTIFICATIONS
	bool "MMI Focaltech fingerprint sensor panel notifications"
	depends on INPUT_FOCAL_FPS_MMI
	default n
	help
	  Enable panel notifications for MMI Focaltech fingerprint sensor.
```

## drivers/input/misc/fpc_fps_mmi/Kconfig
```kconfig
config INPUT_MISC_FPC1020
	tristate "MMI FPC fingerprint sensor"
	default n
	help
	  Say Y here if you wish to include support for MMI FPC fingerprint sensor.
	  If unsure, say N.

config INPUT_MISC_FPC1020_SAVE_TO_CLASS_DEVICE
	bool "MMI FPC fingerprint sensor sysfs support"
	default n
	depends on INPUT_MISC_FPC1020
	help
	  Say Y here if you wish to include support for MMI FPC fingerprint sensor
	  sysfs.
	  If unsure, say N.

config INPUT_MISC_FPC1020_SUPPORT_PIN_CTRL
	bool "MMI FPC fingerprint sensor pinctrl support"
	default n
	depends on INPUT_MISC_FPC1020
	help
	  Say Y here if you wish to include pinctrl support for MMI FPC fingerprint sensor.
	  If unsure, say N.
```

## drivers/input/misc/goodix_fod_mmi/Kconfig
```kconfig
config INPUT_GOODIX_FOD_MMI
	tristate "MMI Goodix FOD sensor"
	default n
	help
	  Say Y here if you wish to include support for MMI Goodix FOD sensor.
	  If unsure, say N.

config GOODIX_DRM_PANEL_NOTIFICATIONS
	bool "MMI Goodix FOD sensor DRM panel notifications"
	depends on INPUT_GOODIX_FOD_MMI
	default n
	help
	  Enable DRM panel notifications for MMI Goodix FOD sensor.

config INPUT_MISC_GOODIX_FOD_SOFTDEP
	bool "MMI Goodix FOD sensor soft dependency on GPIO_PCAL6408"
	depends on INPUT_GOODIX_FOD_MMI
	default n
	help
	  Enable soft dependency on GPIO_PCAL6408 for MMI Goodix FOD sensor.
```

## drivers/input/misc/rbs_fod_mmi/Kconfig
```kconfig
config INPUT_RBS_FOD_MMI
	tristate "MMI RBS FOD sensor"
	default n
	help
	  Say Y here if you wish to include support for MMI RBS FOD sensor.
	  If unsure, say N.
```

## drivers/input/misc/rbs_fps_mmi/Kconfig
```kconfig
config INPUT_EGIS_FPS_MMI
	tristate "MMI egistec fingerprint sensor"
	default n
	help
	  Say Y here if you wish to include support for MMI egistec fingerprint sensor.
	  If unsure, say N.

config INPUT_EGIS_ET721_FOD
	bool "FOD Support for MMI egistec fingerprint sensor"
	default n
	depends on INPUT_EGIS_FPS_MMI
	help
	  Say Y here if you wish to include FOD support for MMI egistec fingerprint sensor.
	  If unsure, say N.
```

## drivers/input/touchscreen/chipone_tddi_v2_mmi/Kconfig
```kconfig
config TOUCHSCREEN_CHIPONE_V2_MMI
	tristate "CHIPONE TDDI V2 Touchscreen"
	default n
	help
	  Say Y here if you have a Chipone flash touchscreen connected
	  to your system by SPI bus.

	  If unsure, say N.

config TOUCHSCREEN_CHIPONE_V2_MMI_ESD
	bool "ESD detection"
	depends on TOUCHSCREEN_CHIPONE_V2_MMI
	default n
	help
	  Say Y here if you want to have ESD detection support.

	  If unsure, say N.

config TOUCHSCREEN_CHIPONE_V2_MMI_ENABLE_DOUBLE_TAP
	bool "Enable double tap"
	depends on TOUCHSCREEN_CHIPONE_V2_MMI
	default n
	help
	  Say Y here if you want to have double tap support.

	  If unsure, say N.

config TOUCHSCREEN_CHIPONE_V2_MMI_GTP_LAST_TIME
	bool "GTP last time"
	depends on TOUCHSCREEN_CHIPONE_V2_MMI
	default n
	help
	  Say Y here if you want to have GTP last time support.

	  If unsure, say N.

config TOUCHSCREEN_CHIPONE_V2_MMI_STOWED_MODE_EN
	bool "Enable stowed mode"
	depends on TOUCHSCREEN_CHIPONE_V2_MMI
	default n
	help
	  Say Y here if you want to have stowed mode support.

	  If unsure, say N.

config TOUCHSCREEN_CHIPONE_V2_MMI_PM_BRL_SPI
	bool "SPI interface for touchscreen"
	depends on TOUCHSCREEN_CHIPONE_V2_MMI
	default n
	help
	  Say Y here if you want to have SPI interface support.

	  If unsure, say N.

config TOUCHSCREEN_CHIPONE_V2_MMI_CHECK_DEVICE_BOOTMODE
	bool "Check device boot mode"
	depends on TOUCHSCREEN_CHIPONE_V2_MMI
	default n
	help
	  Say Y here if you want to have device boot mode check support.

	  If unsure, say N.
```

## drivers/input/touchscreen/goodix_berlin_mmi/Kconfig
```kconfig
#
# Goodix touchscreen driver configuration
#
menuconfig TOUCHSCREEN_GOODIX_BRL_MMI
	tristate "MMI Goodix berlin touchscreen"
	default n
	help
	  Say Y here if you have a MMI Goodix berlin series touch controller
	  to your system.

	  If build module, say M.
	  If unsure, say N.

if TOUCHSCREEN_GOODIX_BRL_MMI

config TOUCHSCREEN_GOODIX_BRL_MMI_SPI
	bool "support SPI bus connection"
	help
	  Say Y here if the touchscreen is connected via SPI bus.

config TOUCHSCREEN_GOODIX_BRL_MMI_FOD
	bool "Enable FOD"
	help
	  Say Y here to support FOD.

config TOUCHSCREEN_GOODIX_BRL_MMI_LIMIT_USE_SUPPLIER
	bool "Support using supplier"
	help
	  Say Y here to support using supplier.

config TOUCHSCREEN_GOODIX_BRL_MMI_ENABLE_PM_QOS
	bool "Enable PM QoS"
	help
	  Say Y here to support PM QoS.

config TOUCHSCREEN_GOODIX_BRL_MMI_ESD_ENABLE
	bool "Support ESD"
	help
	  Say Y here to support ESD.

config TOUCHSCREEN_GOODIX_BRL_MMI_SAVE_IN_CSV
	bool "Factory calibration"
	help
	  Say Y here to support factory calibration.

config TOUCHSCREEN_GOODIX_BRL_MMI_LAST_TIME
	bool "Support last time"
	help
	  Say Y here to support last time.

config TOUCHSCREEN_GOODIX_BRL_MMI_DDA_STYLUS
	bool "Support stylus"
	help
	  Say Y here to support stylus.

config TOUCHSCREEN_GOODIX_BRL_MMI_DDA_PASSIVE_STYLUS
	bool "Support passive stylus"
	help
	  Say Y here to support passive stylus.

config TOUCHSCREEN_GOODIX_BRL_MMI_ENABLE_PALM
	bool "Support palm detection"
	help
	  Say Y here to support palm detection.

config TOUCHSCREEN_GOODIX_BRL_MMI_PALM_CANCEL
	bool "Support palm cancel"
	help
	  Say Y here to support palm cancel.

config TOUCHSCREEN_GOODIX_BRL_MMI_PASSIVE_PEN_NOTIFIER
	bool "Support pen notifier"
	help
	  Say Y here to support pen notifier.

endif
```

## drivers/input/touchscreen/ilitek_v3_mmi/Kconfig
```kconfig
config TOUCHSCREEN_ILITEK_V3_MMI
	tristate "MMI Ilitek V3 Touchscreen"
	default n
	help
	  Say Y here if you have an MMI Ilitek V3 touchscreen connected
	  to your system by SPI bus.

	  If unsure, say N.

config TOUCHSCREEN_ILITEK_V3_MMI_ENABLE_DOUBLE_TAP
	bool "Enable double tap"
	depends on TOUCHSCREEN_ILITEK_V3_MMI
	default n
	help
	  Say Y here to enable double tap for MMI Ilitek V3 touchscreen.

	  If unsure, say N.

config TOUCHSCREEN_ILITEK_V3_MMI_USES_DOUBLE_TAP_CTRL
	bool "Double tap control"
	depends on TOUCHSCREEN_ILITEK_V3_MMI
	default n
	help
	  Say Y here to enable double tap control for MMI Ilitek V3 touchscreen.

	  If unsure, say N.

config TOUCHSCREEN_ILITEK_V3_MMI_SET_TOUCH_STATE
	bool "Set touch state"
	depends on TOUCHSCREEN_ILITEK_V3_MMI
	default n
	help
	  Say Y here to enable touch state for MMI Ilitek V3 touchscreen.

	  If unsure, say N.

config TOUCHSCREEN_ILITEK_V3_MMI_RESUME_BY_DDI
	bool "Resume by DDI"
	depends on TOUCHSCREEN_ILITEK_V3_MMI
	default n
	help
	  Say Y here to enable resume by DDI for MMI Ilitek V3 touchscreen.

	  If unsure, say N.

config TOUCHSCREEN_ILITEK_V3_MMI_CHARGER
	bool "Charger support"
	depends on TOUCHSCREEN_ILITEK_V3_MMI
	default n
	help
	  Say Y here to enable charger support for MMI Ilitek V3 touchscreen.

	  If unsure, say N.

config TOUCHSCREEN_ILITEK_V3_MMI_MTK_CHECK_PANEL
	bool "MTK panel check"
	depends on TOUCHSCREEN_ILITEK_V3_MMI
	default n
	help
	  Say Y here to enable MTK panel check for MMI Ilitek V3 touchscreen.

	  If unsure, say N.

config TOUCHSCREEN_ILITEK_V3_MMI_MULTI_TP_MODULE
	bool "Multi TP module"
	depends on TOUCHSCREEN_ILITEK_V3_MMI
	default n
	help
	  Say Y here to enable multi TP module for MMI Ilitek V3 touchscreen.

	  If unsure, say N.

config TOUCHSCREEN_ILITEK_V3_MMI_LAST_TIME
	bool "Touch last time"
	depends on TOUCHSCREEN_ILITEK_V3_MMI
	default n
	help
	  Say Y here to enable touch last time for MMI Ilitek V3 touchscreen.

	  If unsure, say N.

config TOUCHSCREEN_ILITEK_V3_MMI_STOWED_MODE_EN
	bool "Enable stowed mode"
	depends on TOUCHSCREEN_ILITEK_V3_MMI
	default n
	help
	  Say Y here to enable stowed mode for MMI Ilitek V3 touchscreen.

	  If unsure, say N.
```

## drivers/media/platform/msm/camera/cam_sensor_module/cam_cci/Kconfig
```kconfig
config CAMERA_CCI_INTF
	tristate "Moto camera CCI interface"
	default n
	help
	  Say Y here if you wish to include support for Moto camera CCI interface.
	  If unsure, say N.
```

## drivers/nfc/sn1xx/Kconfig
```kconfig
config NFC_SN1XX
	tristate "QTI NFC for SN1xx"
	help
	  This enables the QTI NFC driver for SN1xx based devices.

	  If unsure, say N.
```

## drivers/nfc/sn2xx/Kconfig
```kconfig
config NFC_SN2XX
	tristate "QTI NFC for SN2xx"
	help
	  This enables the QTI NFC driver for SN2xx based devices.

	  If unsure, say N.
```

## drivers/power/qpnp_adaptive_charge/Kconfig
```kconfig
config QPNP_ADAPTIVE_CHARGE
	tristate "QPNP ADAPTIVE CHARGE"
	default n
	help
	  Say Y here if you have a qpnp adaptive charge compatible
	  device connected.

	  This driver can also be built as a module.  If so, the module
	  will be called qpnp_adaptive_charge.

config USE_MMI_CHARGER
	bool "Use MMI charger"
	depends on QPNP_ADAPTIVE_CHARGE
	default n
	help
	  Say Y here to use MMI charger.

	  If unsure, say N.

config ADAPTIVE_TOLERANCE_OPTIMIZATION
	bool "Enable adaptive tolerance optimization"
	depends on QPNP_ADAPTIVE_CHARGE
	default n
	help
	  Say Y here to enable adaptive tolerance optimization.

	  If unsure, say N.
```

## drivers/power/sm5602_fg_mmi/Kconfig
```kconfig
config MMI_SM5602_FG
        tristate "MMI SM5602 fuel gauge"
	default n
	help
	  Say Y here if you have an MMI SM5602 fuel gauge in your system.

	  To compile this driver as a module, choose M here: the
	  module will be called sm5602_fg_mmi.
```

## drivers/usb/pd/Kconfig
```kconfig
# SPDX-License-Identifier: GPL-2.0-only
#
# USB Power Delivery driver configuration
#
menu "USB Power Delivery"

config USB_PD
	def_bool n

config USB_PD_POLICY
	tristate "USB Power Delivery Protocol and Policy Engine"
	depends on EXTCON
	depends on TYPEC
	depends on IIO
	select USB_PD
	help
          Say Y here to enable USB PD protocol and policy engine.
	  This driver provides a class that implements the upper
	  layers of the USB Power Delivery stack. It requires a
	  PD PHY driver in order to transmit and receive PD
	  messages on its behalf.

config QPNP_USB_PDPHY
	tristate "QPNP USB Power Delivery PHY"
	depends on SPMI
	help
          Say Y here to enable QPNP USB PD PHY peripheral driver
	  which communicates over the SPMI bus.
	  The is used to handle the PHY layer communication of the
	  Power Delivery stack.

config MOT_SET_SRC_CAP_5V1A
	bool "Set PD source capabilty 5V1A"
	default n
	help
	  Say Y to select the src caps 5V1A. It should match with the OTG max
	  max current.
endmenu
```
