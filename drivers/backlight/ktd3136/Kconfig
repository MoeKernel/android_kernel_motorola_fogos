## drivers/backlight/ktd3136/Kconfig
```kconfig
config LEDS_KTD3136
	tristate "KTD3136 LED driver"
	default n
	help
	  Say Y here if you have a ktd3136 compatible
	  device connected.

	  This driver can also be built as a module.  If so, the module
	  will be called ktd3136_bl.
```

## drivers/backlight/sm5350/Kconfig
```kconfig
config LEDS_SM5350
	tristate "LED support for SM5350"
	depends on LEDS_CLASS
	depends on I2C
	default n
	help
	  Say Y here if you have a sm5350 compatible
	  device connected.

	  This driver can also be built as a module.  If so, the module
	  will be called sm5350_bl.
```

## drivers/input/touchscreen/ili9882_mmi/Kconfig
```kconfig
config INPUT_TOUCHSCREEN_ILI_9882_MMI
    tristate "Ilitek Touchscreen Driver 9882 MMI"
    default n
    help
      Say Y here if you wish to include support for Ilitek Touchscreen Driver 9882 MMI.

      If unsure, say N.

      To compile this driver as a module, choose M here: the
      module will be called ili9882_mmi.

config INPUT_TOUCHSCREEN_ILI_9882_MMI_ENABLE_DOUBLE_TAP
    bool "Ilitek Touchscreen Driver 9882 MMI Double tap"
    depends on INPUT_TOUCHSCREEN_ILI_9882_MMI
    depends on SENSORS_CLASS
    default n
    help
      Say Y here if you want to have double tap support on Ilitek 9882 MMI.

      If unsure, say N.

config INPUT_TOUCHSCREEN_ILI_9882_MMI_NOTIFY_TOUCH_STATE
    bool "Ilitek Touchscreen Driver 9882 MMI Touch state"
    depends on INPUT_TOUCHSCREEN_ILI_9882_MMI
    default n
    help
      Say Y here if you want to have touch state support on Ilitek 9882 MMI.

      If unsure, say N.

config INPUT_TOUCHSCREEN_ILI_9882_MMI_PANEL_NOTIFICATIONS
    bool "Ilitek Touchscreen Driver 9882 MMI Panel notifications"
    depends on INPUT_TOUCHSCREEN_ILI_9882_MMI
    default n
    help
      Say Y here if you want to have panel notifications support on Ilitek 9882 MMI.

      If unsure, say N.

config INPUT_TOUCHSCREEN_ILI_9882_MMI_RESUME_BY_DDI
    bool "Ilitek Touchscreen Driver 9882 MMI Resume by DDI"
    depends on INPUT_TOUCHSCREEN_ILI_9882_MMI
    default n
    help
      Say Y here if you want to have resume by DDI support on Ilitek 9882 MMI.

      If unsure, say N.

config INPUT_TOUCHSCREEN_ILI_9882_MMI_FW_PANEL
    bool "Ilitek Touchscreen Driver 9882 MMI FW panel"
    depends on INPUT_TOUCHSCREEN_ILI_9882_MMI
    default n
    help
      Say Y here if you want to have FW panel support on Ilitek 9882 MMI.

      If unsure, say N.

config INPUT_TOUCHSCREEN_ILI_9882_MMI_SUSPEND_PWROFF
    bool "Ilitek Touchscreen Driver 9882 MMI Suspend power-off"
    depends on INPUT_TOUCHSCREEN_ILI_9882_MMI
    default n
    help
      Say Y here if you want to have suspend power-off support on Ilitek 9882 MMI.

      If unsure, say N.

config INPUT_TOUCHSCREEN_ILI_9882_MMI_CHARGER
    bool "Ilitek Touchscreen Driver 9882 MMI Charger"
    depends on INPUT_TOUCHSCREEN_ILI_9882_MMI
    default n
    help
      Say Y here if you want to have charger support on Ilitek 9882 MMI.

      If unsure, say N.

config INPUT_TOUCHSCREEN_ILI_9882_MMI_ESD
    bool "Ilitek Touchscreen Driver 9882 MMI ESD"
    depends on INPUT_TOUCHSCREEN_ILI_9882_MMI
    default n
    help
      Say Y here if you want to have ESD support on Ilitek 9882 MMI.

      If unsure, say N.

config INPUT_TOUCHSCREEN_ILI_9882_MMI_PEN_NOTIFIER
    bool "Ilitek Touchscreen Driver 9882 MMI Pen notifier"
    depends on INPUT_TOUCHSCREEN_ILI_9882_MMI
    default n
    help
      Say Y here if you want to have pen notifier support on Ilitek 9882 MMI.

      If unsure, say N.

config INPUT_TOUCHSCREEN_ILI_9882_MMI_GESTURE
    bool "Ilitek Touchscreen Driver 9882 MMI Gesture"
    depends on INPUT_TOUCHSCREEN_ILI_9882_MMI
    default n
    help
      Say Y here if you want to have gesture support on Ilitek 9882 MMI.

      If unsure, say N.

config INPUT_TOUCHSCREEN_ILI_9882_MMI_PANEL_GESTURE
    bool "Ilitek Touchscreen Driver 9882 MMI Panel gesture"
    depends on INPUT_TOUCHSCREEN_ILI_9882_MMI
    default n
    help
      Say Y here if you want to have panel gesture support on Ilitek 9882 MMI.

      If unsure, say N.

config INPUT_TOUCHSCREEN_ILI_9882_MMI_PASSIVE_PEN
    bool "Ilitek Touchscreen Driver 9882 MMI Passive pen"
    depends on INPUT_TOUCHSCREEN_ILI_9882_MMI
    default n
    help
      Say Y here if you want to have passive pen support on Ilitek 9882 MMI.

      If unsure, say N.

config INPUT_TOUCHSCREEN_ILI_9882_MMI_LAST_TIME
    bool "Ilitek Touchscreen Driver 9882 MMI Timestamp"
    depends on INPUT_TOUCHSCREEN_ILI_9882_MMI
    default n
    help
      Say Y here if you want to have timestamp support on Ilitek 9882 MMI.

      If unsure, say N.
```

## drivers/power/rt9426a_fg_mmi/Kconfig
```kconfig
config RT9426A_FG_MMI
	tristate "RT9426A FGADC Device Driver"
	default n
	help
	  Say Y here if you have RT9426A FGADC Device support
	  in your system.

	  If unsure, say N.

	  To compile this driver as a module, choose M here: the
	  module will be called rt9426a_fg_mmi.
```
